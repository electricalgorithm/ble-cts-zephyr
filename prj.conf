## CMakeLists.txt
```
# SPDX-License-Identifier: Apache-2.0

cmake_minimum_required(VERSION 3.20.0)
find_package(Zephyr REQUIRED HINTS $ENV{ZEPHYR_BASE})
project(peripheral)

FILE(GLOB app_sources src/*.c)
target_sources(app PRIVATE ${app_sources})
```

## prj.conf
```kconfig
# Bluetooth Settings
CONFIG_BT=y
CONFIG_BT_DEVICE_NAME="ZephyrWatch"
CONFIG_BT_PERIPHERAL=y

# If not set BT_SMP &  BT_SIGNING, the device will not be able to pair with other devices.
CONFIG_BT_SMP=y
CONFIG_BT_SIGNING=y
CONFIG_BT_KEYS_OVERWRITE_OLDEST=y
CONFIG_BT_PRIVACY=y

# Log Settings
CONFIG_LOG=y

# Settings Subsystem
# CONFIG_SETTINGS=y
# CONFIG_BT_SETTINGS=y
# Increased stack due to settings API usage
# CONFIG_SYSTEM_WORKQUEUE_STACK_SIZE=2048


CONFIG_FLASH=y
CONFIG_FLASH_MAP=y
CONFIG_NVS=y
```

## src/main.c
```c
#include <zephyr/kernel.h>
#include <zephyr/logging/log.h>
#include "bluetooth_infra.h"
#include "current_time_service.h"

LOG_MODULE_REGISTER(ZephyrWatch_Main, LOG_LEVEL_INF);


int main() {
	int err = enable_bluetooth_and_start_advertisement();
	if (err) {
		LOG_ERR("Failed to enable Bluetooth and start advertisement (err %d)", err);
		return err;
	}

	for (int i = 0; i < 15; i++) {
		k_sleep(K_SECONDS(2));

		struct current_time time = get_current_time();
		LOG_INF("Current time: %d-%d-%d %d:%d:%d",
			time.year, time.month, time.day,
			time.hours, time.minutes, time.seconds);
	}

	err = disable_bluetooth_and_stop_advertisement();
	if (err) {
		LOG_ERR("Failed to disable Bluetooth and stop advertisement (err %d)", err);
		return err;
	}

	return 0;
}
```
